## conf/distro/carles-everest.conf
```bitbake
# meta-carles/conf/distro/carles-everest.conf
require conf/distro/poky.conf

DISTRO = "carles-everest"
DISTRO_NAME = "Carles EVerest Distro"
DISTRO_VERSION = "1.0"
DISTRO_CODENAME = "volcano"

# Enable systemd as the init manager
DISTRO_FEATURES:append = " systemd"
VIRTUAL-RUNTIME_init_manager = "systemd"
VIRTUAL-RUNTIME_initscripts = ""
```

## conf/layer.conf
```bitbake
# meta-carles/conf/layer.conf
# We have a conf and classes directory, add to BBPATH
BBPATH .= ":${LAYERDIR}"

# We have recipes-* directories, add to BBFILES
BBFILES += "${LAYERDIR}/recipes-*/*/*.bb \
            ${LAYERDIR}/recipes-*/*/*.bbappend"

BBFILE_COLLECTIONS += "carles"
BBFILE_PATTERN_carles = "^${LAYERDIR}/"
BBFILE_PRIORITY_carles = "6"

LAYERSERIES_COMPAT_carles = "kirkstone"
```
